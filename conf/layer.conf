## conf/layer.conf
```bitbake
# We have a conf and classes directory, add to BBPATH
BBPATH .= ":${LAYERDIR}"

# We have recipes-* directories, add to BBFILES
BBFILES += "${LAYERDIR}/backports/${LAYERSERIES_COMPAT_core}/recipes-*/*/*.bb"
BBFILES += "${LAYERDIR}/backports/${LAYERSERIES_COMPAT_core}/recipes-*/*/*.bbappend"
BBFILES += "${LAYERDIR}/recipes-*/*/*.bb ${LAYERDIR}/recipes-*/*/*.bbappend"

BBFILE_COLLECTIONS += "intel-ese-main"
BBFILE_PATTERN_intel-ese-main = "^${LAYERDIR}/"
BBFILE_PRIORITY_intel-ese-main = "6"

# This should only be incremented on significant changes that will
# cause compatibility issues with other layers
LAYERVERSION_intel-ese-main = "1"

LAYERDEPENDS_intel-ese-main = "core intel"
LAYERSERIES_COMPAT_intel-ese-main = "dunfell hardknott"

# Additional license directories.
LICENSE_PATH += "${LAYERDIR}/custom-licenses"

INHERIT += "perllocal-fix"

# meta-tpm
BBFILES_DYNAMIC += "tpm2:${LAYERDIR}/backports/${LAYERSERIES_COMPAT_core}/dynamic/meta-tpm2/recipes-*/*/*.bbappend"
BBFILES_DYNAMIC += "tpm2:${LAYERDIR}/dynamic/meta-tpm2/recipes-*/*/*.bbappend"

# meta-clang
BBFILES_DYNAMIC += "clang-layer:${LAYERDIR}/backports/${LAYERSERIES_COMPAT_core}/dynamic/meta-clang/recipes-*/*/*.bbappend \
                    clang-layer:${LAYERDIR}/backports/${LAYERSERIES_COMPAT_core}/dynamic/meta-intel/dynamic-layers/clang-layer/recipes-*/*/*.bbappend \
                    clang-layer:${LAYERDIR}/backports/${LAYERSERIES_COMPAT_core}/dynamic/meta-clang/recipes-*/*/*.bb"

BBFILES_DYNAMIC += "clang-layer:${LAYERDIR}/dynamic/meta-clang/recipes-*/*/*.bbappend \
                    clang-layer:${LAYERDIR}/dynamic/meta-intel/dynamic-layers/clang-layer/recipes-*/*/*.bbappend \
                    clang-layer:${LAYERDIR}/dynamic/meta-clang/recipes-*/*/*.bb"

# meta-mender
BBFILES_DYNAMIC += "mender:${LAYERDIR}/backports/${LAYERSERIES_COMPAT_core}/dynamic/meta-mender/meta-mender-core/recipes-*/*/*.bbappend"
BBFILES_DYNAMIC += "mender:${LAYERDIR}/dynamic/meta-mender/meta-mender-core/recipes-*/*/*.bbappend"

# meta-security
BBFILES_DYNAMIC += "security:${LAYERDIR}/backports/${LAYERSERIES_COMPAT_core}/dynamic/meta-security/recipes-*/*/*.bbappend"
BBFILES_DYNAMIC += "security:${LAYERDIR}/dynamic/meta-security/recipes-*/*/*.bbappend"

# meta-dpdk
BBFILES_DYNAMIC += "dpdk:${LAYERDIR}/backports/${LAYERSERIES_COMPAT_core}/dynamic/meta-dpdk/recipes-*/*/*.bbappend"
BBFILES_DYNAMIC += "dpdk:${LAYERDIR}/dynamic/meta-dpdk/recipes-*/*/*.bbappend"

# meta openembedded
BBFILES_DYNAMIC += "openembedded-layer:${LAYERDIR}/backports/${LAYERSERIES_COMPAT_core}/dynamic/meta-oe/recipes-*/*/*.bbappend \
                    openembedded-layer:${LAYERDIR}/backports/${LAYERSERIES_COMPAT_core}/dynamic/meta-oe/recipes-*/*/*.bb"
BBFILES_DYNAMIC += "multimedia-layer:${LAYERDIR}/backports/${LAYERSERIES_COMPAT_core}/dynamic/meta-multimedia/recipes-*/*/*.bbappend"

BBFILES_DYNAMIC += "openembedded-layer:${LAYERDIR}/dynamic/meta-oe/recipes-*/*/*.bbappend \
                    openembedded-layer:${LAYERDIR}/dynamic/meta-oe/recipes-*/*/*.bb"
BBFILES_DYNAMIC += "multimedia-layer:${LAYERDIR}/dynamic/meta-multimedia/recipes-*/*/*.bbappend"

# meta-security
BBFILES_DYNAMIC += "security:${LAYERDIR}/backports/${LAYERSERIES_COMPAT_core}/dynamic/meta-security/recipes-*/*/*.bbappend"
BBFILES_DYNAMIC += "security:${LAYERDIR}/dynamic/meta-security/recipes-*/*/*.bbappend"
```
